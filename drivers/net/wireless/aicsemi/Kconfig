## drivers/net/wireless/aicsemi/Kconfig
```kconfig
# SPDX-License-Identifier: GPL-2.0-only
config WLAN_VENDOR_AICSEMI
	bool "AICSemi devices"
	default y
	help
	  If you have a wireless card belonging to this class, say Y.

if WLAN_VENDOR_AICSEMI

config AIC8800
	tristate "AICSemi AIC8800 SDIO Wi-Fi"
	depends on CFG80211 && MMC && m
	help
	  Vendor driver for the AICSemi AIC8800 family (AIC8800D80) on
	  SDIO, ported from the Sipeed AX620E SDK. Builds the aic8800_bsp
	  and aic8800_fdrv modules; firmware is read from the directory
	  given by the aic8800_bsp aic_fw_path parameter.

config AIC8800_BT
	bool "AICSemi AIC8800 Bluetooth over SDIO"
	depends on AIC8800 && BT
	default y
	help
	  The AIC8800's Bluetooth controller as an HCI device. Its packets
	  travel in the Wi-Fi firmware's SDIO messages (the fmacfwbt
	  firmware), so the HCI device comes and goes with the Wi-Fi driver.

endif
```
